/*
 * Copyright (c) 2020 ZMK Contributors
 *
 * SPDX-License-Identifier: MIT
 */

#include "keyball39.dtsi"

&kscan0 {
    col-gpios
        = <&rp2040_gpio 10 GPIO_ACTIVE_HIGH>
        , <&rp2040_gpio 11 GPIO_ACTIVE_HIGH>
        , <&rp2040_gpio 12 GPIO_ACTIVE_HIGH>
        , <&rp2040_gpio 13 GPIO_ACTIVE_HIGH>
        , <&rp2040_gpio 14 GPIO_ACTIVE_HIGH>
        , <&rp2040_gpio 15 GPIO_ACTIVE_HIGH>
        ;
};
